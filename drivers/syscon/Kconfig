## drivers/syscon/Kconfig
```kconfig
# SYSCON configuration options

# Copyright (c) 2021 Carlo Caione <ccaione@baylibre.com>
# SPDX-License-Identifier: Apache-2.0

#
# SYSCON options
#
menuconfig SYSCON
	bool "SYSCON (System Controller) drivers"
	help
	  SYSCON (System Controller) drivers. System controller node represents
	  a register region containing a set of miscellaneous registers. The
	  registers are not cohesive enough to represent as any specific type
	  of device. The typical use-case is for some other node's driver, or
	  platform-specific code, to acquire a reference to the syscon node and
	  extract information from there.

if SYSCON

module = SYSCON
module-str = syscon
source "subsys/logging/Kconfig.template.log_config"

DT_COMPAT_SYSCON := syscon

choice SYSCON_TYPE
	prompt "Select the type of syscon driver to initialize"
	default SYSCON_GENERIC if $(dt_compat_enabled,$(DT_COMPAT_SYSCON)) && !ZTEST
	default SYSCON_EMUL if $(dt_compat_enabled,$(DT_COMPAT_SYSCON)) && ZTEST

config SYSCON_GENERIC
	bool "Generic SYSCON (System Controller) driver"
	help
	  Enable generic SYSCON (System Controller) driver

config SYSCON_EMUL
	bool "Emulated SYSCON (System Controller) driver"
	help
	  Enable an emulated SYSCON (System Controller) driver which
	  reads/writes to an allocated memory region instead of MMIO.

endchoice # SYSCON_TYPE

config SYSCON_INIT_PRIORITY_DEVICE
	int "SYSCON (System Controller) init device priority"
	default 50
	help
	  This option controls the priority of the syscon device
	  initialization. Higher priority ensures that the device is
	  initialized earlier in the startup cycle. If unsure, leave at default
	  value

endif # SYSCON
```

## dts/bindings/memory-controllers/nuvoton,npcx-bbram.yaml
```yaml
# Copyright (c) 20201 Google Inc.
# SPDX-License-Identifier: Apache-2.0

description: Nuvoton, NPCX Battery Backed RAM node

compatible: "nuvoton,npcx-bbram"

include: base.yaml

properties:
    "#address-cells":
        required: false
        const: 1
    "#size-cells":
        required: false
        const: 1
    reg:
        required: true
```

## samples/sensor/sensor_v2/dts/bindings/sample-sensors.yaml
```yaml
description: |
  Various arrays in order to configure the sample app

compatible: "sample-sensors"

properties:
  accels:
    type: phandles
  gyros:
    type: phandles
```
